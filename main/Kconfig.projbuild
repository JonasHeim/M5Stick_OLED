## main/Kconfig.projbuild
```kconfig
menu "Example Configuration"

    config M5STICK_OLED
        int "Blink GPIO number"
        range 0 34
        default 19
        help
            GPIO number (IOxx) to blink on and off.

            Some GPIOs are used for other purposes (flash connections, etc.) and cannot be used to blink.

            GPIOs 35-39 are input-only so cannot be used as outputs.

endmenu
```
